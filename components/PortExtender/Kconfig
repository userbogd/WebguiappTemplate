## components/PortExtender/Kconfig
```kconfig
menu "Virtual GPO configuration"
    config PORTS_EXTENDER_ENABLE
        bool "Enabled port extender"
        default n
        help
            Set enabled port extender
    if  PORTS_EXTENDER_ENABLE       
    menu "PINs Configuration"
        config VGPO_MOSI_PIN
            int "VGPO MOSI Pin Number"
            default 25
            range 0 33
            help
                Pin number of VGPO MOSI.
         
        config VGPO_CLK_PIN
            int "VGPO CLOCK Pin Number"
            default 26
            range 0 33
            help
                Pin number of VGPO CLOCK.
       
        config VGPO_LAT_PIN
            int "VGPO LAT Pin Number"
            default 27
            range 0 33
            help
                Pin number of VGPO LATCH.
 
    endmenu
    endif
endmenu
```

## main/Kconfig.projbuild
```kconfig
menu "LED app settings"    
	
	config GPIO_RANGE_MIN
        int
        default -1

    config GPIO_RANGE_MAX
        int
        default 39 if IDF_TARGET_ESP32
        default 46 if IDF_TARGET_ESP32S2
        default 19 if IDF_TARGET_ESP32C3
        default 48 if IDF_TARGET_ESP32S3    
        
	
	menu "LED strip settings"
		
		config LED_STRIP_NUMBER
        	int "LED's number in strip"
        	default 1
        	range 1 1024
        
        config LED_STRIP_GPIO
            int "LED strip GPIO"
            default 35
            range 0 GPIO_RANGE_MAX
	endmenu                

endmenu
```

## sdkconfig.defaults
```kconfig
#
# Partition Table
#
CONFIG_PARTITION_TABLE_CUSTOM=y
CONFIG_PARTITION_TABLE_CUSTOM_FILENAME="partitions_user_1ota_4M.csv"
CONFIG_PARTITION_TABLE_FILENAME="partitions_user_1ota_4M.csv"
CONFIG_PARTITION_TABLE_OFFSET=0x8000
CONFIG_PARTITION_TABLE_MD5=y
# end of Partition Table

#
# WebGUIApp
#
CONFIG_DEVICE_MODEL_NAME="WEBGUIAPP"
CONFIG_MAIN_FUNCTIONAL_BUTTON_GPIO=-1

#
# OTA settings
#
CONFIG_WEBGUIAPP_OTA_HOST="https://firmware.url.com"
# end of OTA settings

#
# SPI settings
#
CONFIG_WEBGUIAPP_SPI_ENABLE=y
CONFIG_SPI_HOST=1
CONFIG_SPI_SCLK_GPIO=35
CONFIG_SPI_MOSI_GPIO=33
CONFIG_SPI_MISO_GPIO=34
# end of SPI settings

#
# WiFi settings
#
CONFIG_WEBGUIAPP_WIFI_ENABLE=y
CONFIG_WEBGUIAPP_WIFI_ON=y
CONFIG_WEBGUIAPP_WIFI_DHCP_ON=y
CONFIG_WEBGUIAPP_WIFI_SSID_AP=""
CONFIG_WEBGUIAPP_WIFI_KEY_AP="123456789"
CONFIG_WEBGUIAPP_WIFI_SSID_STA="YourSTA"
CONFIG_WEBGUIAPP_WIFI_KEY_STA="123456789"
CONFIG_WEBGUIAPP_WIFI_IP_AP="192.168.150.1"
CONFIG_WEBGUIAPP_WIFI_IP_STA="192.168.150.1"
CONFIG_WEBGUIAPP_WIFI_MASK_STA="255.255.255.0"
CONFIG_WEBGUIAPP_WIFI_GATEWAY_STA="192.168.150.1"
# end of WiFi settings

#
# Ethernet settings
#
CONFIG_WEBGUIAPP_ETHERNET_ENABLE=n
CONFIG_WEBGUIAPP_ETHERNET_ON=y
CONFIG_WEBGUIAPP_ETH_IP_DEFAULT="192.168.160.1"
CONFIG_WEBGUIAPP_ETH_MASK_DEFAULT="255.255.255.0"
CONFIG_WEBGUIAPP_ETH_GATEWAY_DEFAULT="192.168.160.1"
# CONFIG_WEBGUIAPP_ETHERNET_DHCP_DEFAULT is not set
CONFIG_USE_SPI_ETHERNET=y
CONFIG_SPI_ETHERNETS_NUM=1
# CONFIG_DM9051 is not set
# CONFIG_KSZ8851SNL is not set
CONFIG_W5500=y
CONFIG_ETH_SPI_CLOCK_MHZ=25
CONFIG_ETH_SPI_CS0_GPIO=36
CONFIG_ETH_SPI_INT0_GPIO=47
CONFIG_ETH_SPI_PHY_RST0_GPIO=48
CONFIG_ETH_SPI_PHY_ADDR0=1
# end of Ethernet settings

#
# GPRS settings
#
CONFIG_WEBGUIAPP_GPRS_ENABLE=n
# CONFIG_WEBGUIAPP_MODEM_AT_ACCESS is not set
CONFIG_WEBGUIAPP_GPRS_ON=y
CONFIG_MODEM_DEVICE_POWER_CONTROL_PIN=-1
CONFIG_MODEM_DEVICE_SIM800=y
# CONFIG_MODEM_DEVICE_BG96 is not set
# CONFIG_MODEM_DEVICE_SIM7600 is not set
CONFIG_MODEM_PPP_APN="internet"
CONFIG_MODEM_PPP_AUTH_USERNAME="gdata"
CONFIG_MODEM_PPP_AUTH_PASSWORD="gdata"
# CONFIG_MODEM_PPP_AUTH_NONE is not set
# CONFIG_MODEM_NEED_SIM_PIN is not set

#
# UART Configuration
#
CONFIG_MODEM_UART_PORT_NUM=0
CONFIG_MODEM_UART_TX_PIN=43
CONFIG_MODEM_UART_RX_PIN=44
CONFIG_MODEM_UART_RTS_PIN=0
CONFIG_MODEM_UART_CTS_PIN=0
CONFIG_MODEM_UART_EVENT_TASK_STACK_SIZE=2048
CONFIG_MODEM_UART_EVENT_TASK_PRIORITY=12
CONFIG_MODEM_UART_EVENT_QUEUE_SIZE=30
CONFIG_MODEM_UART_PATTERN_QUEUE_SIZE=20
CONFIG_MODEM_UART_TX_BUFFER_SIZE=2048
CONFIG_MODEM_UART_RX_BUFFER_SIZE=2048
# end of UART Configuration
# end of GPRS settings

CONFIG_ESPTOOLPY_FLASHMODE_QIO=y
CONFIG_ESPTOOLPY_FLASHFREQ_80M=y
CONFIG_ESPTOOLPY_FLASHSIZE_4MB=y

CONFIG_APP_PROJECT_VER_FROM_CONFIG=y

CONFIG_HTTPD_MAX_REQ_HDR_LEN=1024
CONFIG_LWIP_MAX_SOCKETS=14
CONFIG_SPIFFS_OBJ_NAME_LEN=128


#for modem
# Override some defaults to enable PPP
CONFIG_LWIP_PPP_SUPPORT=y
CONFIG_LWIP_PPP_NOTIFY_PHASE_SUPPORT=y
CONFIG_LWIP_PPP_PAP_SUPPORT=y
CONFIG_LWIP_TCPIP_TASK_STACK_SIZE=4096
# Do not enable IPV6 in dte<->dce link local
CONFIG_LWIP_PPP_ENABLE_IPV6=n
CONFIG_LWIP_DEBUG=y
CONFIG_LWIP_NETIF_DEBUG=y
```
